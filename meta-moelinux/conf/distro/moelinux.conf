## meta-moelinux/conf/distro/moelinux.conf
```bitbake
DISTRO_VERSION = "0.0.1"
DISTRO_CODENAME = "0.0.1"
DISTRO = "moelinux"
DISTRO_NAME = "MangoPi Open Embedded based Linux distribution"

SDK_VENDOR = "-${DISTRO}sdk"

SDK_VERSION = "${@d.getVar('DISTRO_VERSION').replace('snapshot-${DATE}', 'snapshot')}"

MAINTAINER = "Pavel Zhukov <pavel@zhukoff.net>"

TARGET_VENDOR = "-moelinux"

LOCALCONF_VERSION = "2"

DISTRO_VERSION[vardepsexclude] = "DATE"
SDK_VERSION[vardepsexclude] = "DATE"

DISTRO_FEATURES = "${DISTRO_FEATURES_DEFAULT} pam security wayland systemd"
DISTRO_EXTRA_RDEPENDS = " packagegroup-core-boot"
DISTRO_EXTRA_RRECOMMENDS = " kernel-module-rtl8723ds "
DISTRO_FEATURES_DEFAULT:remove = " nfs nfc 3g pcmcia x11 debuginfod"

require conf/distro/include/no-static-libs.inc
require conf/distro/include/yocto-uninative.inc
INHERIT += "uninative"

BB_SIGNATURE_HANDLER ?= "OEEquivHash"
BB_HASHSERVE ??= "auto"

TCLIBC ?= "glibc"

COMPATIBLE_MACHINES = "mangopi-mq-pro"

# Set default hostname to reflect the DISTRO
hostname:pn-base-files = "${DISTRO}-${MACHINE}"
INIT_MANAGER = "systemd"
BB_DANGLINGAPPENDS_WARNONLY:forcevariable = "0"
MOEUSERNAME = "moeuser"
```

## meta-moelinux/conf/layer.conf
```bitbake
# SPDX-FileCopyrightText: Pavel Zhukov <pavel@zhukoff.net>
#
# SPDX-License-Identifier: MIT

BBPATH .= ":${LAYERDIR}"

BBFILES += "${LAYERDIR}/recipes-*/*/*.bb \
            ${LAYERDIR}/recipes-*/*/*.bbappend"

BBFILE_COLLECTIONS += "moelinux"
BBFILE_PATTERN_moelinux = "^${LAYERDIR}/"
LAYERDEPENDS_moelinux = "\
     riscv-layer \
    "

LAYERSERIES_COMPAT_moelinux = "mickledore"
```
